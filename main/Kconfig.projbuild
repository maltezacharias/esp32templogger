## main/Kconfig.projbuild
```kconfig
menu "ESP32 WiFi Temperature Logger Configuration"

    config ESP_WIFI_SSID
        string "WiFi SSID"
        default ""
        help
            SSID (network name) to connect to.

    config ESP_WIFI_PASSWORD
        string "WiFi Password"
        default ""
        help
            WiFi password (WPA or WPA2) to use.

    config RELAIS_GPIO
        int "GPIO driving the relais"
        default "14"
        help
            GPIO number to drive the relais. A relais should be connected to this GPIO
            to turn on/off heating.

    config ONE_WIRE_GPIO
        int "OneWire GPIO number"
        range 0 33
        default 13
        help
            GPIO number (IOxx) to access One Wire Bus.
            Some GPIOs are used for other purposes (flash connections, etc.) and cannot be used.
            GPIOs 34-39 are input-only so cannot be used to drive the One Wire Bus.

    config MAX_SENSORS
        int "Maximum number of OneWire Devices"
        range 1 64
        default 8
        help
            Maximum number of supported OneWire Devices connected to the OneWire Pin,
            limits the memory allocation for device addresses.

    config TEMPERATURE_SAMPLE_PERIOD
        int "Sample temperatures every n millisecons"
        default 10000
        help
            Temperatures will be sampled every n milliseconds. 

    config ENABLE_STRONG_PULLUP_GPIO
        bool "Enable strong pull-up controlled by GPIO (MOSFET)"
        default n
        help
            An external circuit can be used to provide a strong pull-up to the One Wire Bus.
            This is useful when the bus has parasitic-powered devices and extra current is
            required to power them, such as during temperature ADC conversions.

            An example of such a circuit for the ESP32 is a P-channel MOSFET (such as the BS250)
            connected Source-to-Drain between a current-limiting resistor (e.g. 270ohm for 12mA
            max at 3.3V), itself connected to VCC, and the One Wire Bus data line. The Gate is
            connected to the GPIO specified here.

    config STRONG_PULLUP_GPIO
        int "Strong pull-up GPIO number"
        range 0 33
        default 5
        help
            GPIO number (IOxx) to control the strong pull-up on the One Wire Bus, perhaps
            via a P-channel MOSFET between VCC and the One Wire Bus data line.

            This GPIO will be set as an output and driven high during temperature conversion.
            This would enable the MOSFET providing current to the devices.

            At all other times it will be driven low, switching off the MOSFET and allowing
            the One Wire Bus to operate normally.

            Some GPIOs are used for other purposes (flash connections, etc.) and cannot be used.

            GPIOs 34-39 are input-only so cannot be used to drive the One Wire Bus.
        depends on ENABLE_STRONG_PULLUP_GPIO

endmenu
```
